## conf/distro/include/rdk_video_lto.inc
```bitbake
LTO_pn-pxcore-libnode = ""
LTO_pn-netsrvmgr = ""
LTO_pn-tr69hostif = ""
LTO_pn-pxcore-standalone = ""
LTO_pn-servicemanager = ""
LTO_pn-ledmgr = ""
LTO_pn-ledmgr-headers = ""
LTO_pn-wpeframework-clientlibraries = ""
LTO_pn-hwselftest = ""
LTO_pn-brotli = ""
```
